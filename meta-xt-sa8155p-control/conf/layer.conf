## meta-xt-sa8155p-control/conf/layer.conf
```bitbake
# We have a conf and classes directory, add to BBPATH
BBPATH .= ":${LAYERDIR}"

# We have recipes-* directories, add to BBFILES
BBFILES += "${LAYERDIR}/recipes-*/*/*.bb \
            ${LAYERDIR}/recipes-*/*/*.bbappend"

BBFILE_COLLECTIONS += "meta-xt-sa8155p-control"
BBFILE_PATTERN_meta-xt-sa8155p-control = "^${LAYERDIR}/"
BBFILE_PRIORITY_meta-xt-sa8155p-control = "10"

LAYERDEPENDS_meta-xt-sa8155p-control = "core"
LAYERSERIES_COMPAT_meta-xt-sa8155p-control = "kirkstone"
```

## meta-xt-sa8155p-domx/conf/layer.conf
```bitbake
# We have a conf and classes directory, add to BBPATH
BBPATH .= ":${LAYERDIR}"

# We have recipes-* directories, add to BBFILES
BBFILES += "${LAYERDIR}/recipes-*/*/*.bb \
            ${LAYERDIR}/recipes-*/*/*.bbappend"

BBFILE_COLLECTIONS += "meta-xt-sa8155p-domx"
BBFILE_PATTERN_meta-xt-sa8155p-domx = "^${LAYERDIR}/"
BBFILE_PRIORITY_meta-xt-sa8155p-domx = "12"

LAYERDEPENDS_meta-xt-sa8155p-domx = "core"
LAYERSERIES_COMPAT_meta-xt-sa8155p-domx = "kirkstone"
```
